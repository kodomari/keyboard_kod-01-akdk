## boards/shields/kod_01/Kconfig.defconfig
```kconfig
if SHIELD_KOD_01_LEFT
config ZMK_KEYBOARD_NAME
    default "kod_01"
config ZMK_SPLIT_ROLE_CENTRAL
    default y
endif

if SHIELD_KOD_01_LEFT || SHIELD_KOD_01_RIGHT
config ZMK_SPLIT
    default y
endif
```
